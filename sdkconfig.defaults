## sdkconfig.defaults
```kconfig
# ESP32-S3 AS608 Fingerprint Project
# SDK Configuration defaults

# Target
CONFIG_IDF_TARGET="esp32s3"
CONFIG_ESP32S3_DEFAULT_CPU_FREQ_240=y

#Spiram mode
CONFIG_SPIRAM=y
CONFIG_SPIRAM_MODE_QUAD=y

# Flash size
CONFIG_ESPTOOLPY_FLASHSIZE_4MB=y

# Partition Table
CONFIG_PARTITION_TABLE_CUSTOM=y
CONFIG_PARTITION_TABLE_CUSTOM_FILENAME="partitions/4m.csv"

# FreeRTOS
CONFIG_FREERTOS_HZ=1000

# Event Loop - Increase stack for WiFi callbacks
CONFIG_ESP_SYSTEM_EVENT_TASK_STACK_SIZE=10000

# Main Task stack size
CONFIG_ESP_MAIN_TASK_STACK_SIZE=4096

# Log level
CONFIG_LOG_DEFAULT_LEVEL_INFO=y
CONFIG_LOG_DEFAULT_LEVEL=3

# UART driver
CONFIG_UART_ISR_IN_IRAM=y

# ESP Console
CONFIG_ESP_CONSOLE_UART_DEFAULT=y

# HTTP Server - Enable WebSocket support
CONFIG_HTTPD_WS_SUPPORT=y
```
